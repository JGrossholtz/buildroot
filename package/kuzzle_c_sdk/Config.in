## package/kuzzle_c_sdk/Config.in
```kconfig
config BR2_PACKAGE_KUZZLE_C_SDK
	bool "Kuzzle C SDK"
	depends on BR2_PACKAGE_HOST_GO_ARCH_SUPPORTS
	depends on BR2_PACKAGE_HOST_GO_CGO_LINKING_SUPPORTS
	help
	  Kuzzle is an IoT platform, this package installs the C SDK library.
```
